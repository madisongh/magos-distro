## layers/meta-magos/conf/bblayers.conf.sample
```bitbake
# LAYER_CONF_VERSION is increased each time build/conf/bblayers.conf
# changes incompatibly
LCONF_VERSION = "6"

BBPATH = "${TOPDIR}"
BBFILES ?= ""

BBLAYERS ?= " \
  ##OEROOT##/poky/meta \
  ##OEROOT##/meta-linaro-toolchain \
  ##OEROOT##/meta-multimedia \
  ##OEROOT##/meta-freescale \
  ##OEROOT##/meta-tegra \
  ##OEROOT##/meta-magos \
  "

BBLAYERS_NON_REMOVABLE ?= " \
  ##OEROOT##/poky/meta \
  ##OEROOT##/meta-magos \
  "
```

## layers/meta-magos/conf/distro/magos.conf
```bitbake
DISTRO = "magos"
DISTRO_NAME = "MagOS"
DISTRO_LAYER ?= "meta-magos"
DISTRO_BUILDNUM ?= "${@os.getenv('LOGNAME') or os.getenv('USER')}"
DISTRO_BUILDNAME ?= "-${DISTRO_BUILDNUM}"
DISTRO_BASE_VERSION = "2.4${DISTRO_BUILDNAME}"
DISTRO_VERSION = "${DISTRO_BASE_VERSION}${DISTRO_LAYER_REVTAG}"
DISTRO_CODENAME = "klarion"
SDK_VENDOR = "-magosdk"
SDK_VERSION := "${@'${DISTRO_BASE_VERSION}'}"
METADATA_BRANCH = "${DISTRO_LAYER_BRANCH}"
METADATA_REVISION = "${DISTRO_LAYER_REVISION}"

INHERIT += "distro_layer_buildinfo uninative"
require conf/distro/include/yocto-uninative.inc

MAINTAINER = "Matt Madison <matt@madison.systems>"

TARGET_VENDOR = "-magos"

LOCALCONF_VERSION = "1"

DISTRO_FEATURES ?= "alsa ext2 vfat largefile usbgadget usbhost wifi xattr \
		    nfs zeroconf pci pam bluetooth opengl x11 wayland systemd \
		    ${DISTRO_FEATURES_LIBC}"

SDK_NAME = "${DISTRO}-${TCLIBC}-${SDK_ARCH}-${IMAGE_BASENAME}-${TUNE_PKGARCH}"
SDKPATH = "/opt/${DISTRO}/${SDK_VERSION}"

TCLIBCAPPEND = ""

QEMU_TARGETS ?= "arm aarch64"

PREMIRRORS ??= "\
bzr://.*/.*   http://downloads.yoctoproject.org/mirror/sources/ \n \
cvs://.*/.*   http://downloads.yoctoproject.org/mirror/sources/ \n \
git://.*/.*   http://downloads.yoctoproject.org/mirror/sources/ \n \
gitsm://.*/.* http://downloads.yoctoproject.org/mirror/sources/ \n \
hg://.*/.*    http://downloads.yoctoproject.org/mirror/sources/ \n \
osc://.*/.*   http://downloads.yoctoproject.org/mirror/sources/ \n \
p4://.*/.*    http://downloads.yoctoproject.org/mirror/sources/ \n \
svn://.*/.*   http://downloads.yoctoproject.org/mirror/sources/ \n"

MIRRORS =+ "\
ftp://.*/.*      http://downloads.yoctoproject.org/mirror/sources/ \n \
http://.*/.*     http://downloads.yoctoproject.org/mirror/sources/ \n \
https://.*/.*    http://downloads.yoctoproject.org/mirror/sources/ \n"

# The CONNECTIVITY_CHECK_URI's are used to test whether we can succesfully
# fetch from the network (and warn you if not). To disable the test set
# the variable to be empty.
# Git example url: git://git.yoctoproject.org/yocto-firewall-test;protocol=git;rev=HEAD
CONNECTIVITY_CHECK_URIS ?= "https://www.example.com/"

PACKAGE_CLASSES ?= "package_deb"
IMAGE_CLASSES_append = " image_types_tegra"

SANITY_TESTED_DISTROS ?= " \
            ubuntu-16.04 \n \
            "
# For CUDA 8.0 compatibility (sort of)
GCCVERSION_aarch64 = "linaro-5.3"

# Default hash policy for distro
BB_SIGNATURE_HANDLER ?= 'OEBasicHash'
#
# OELAYOUT_ABI allows us to notify users when the format of TMPDIR changes in 
# an incompatible way. Such changes should usually be detailed in the commit
# that breaks the format and have been previously discussed on the mailing list 
# with general agreement from the core team.
#
OELAYOUT_ABI = "12"
#
# Have our image names include version string
#
IMAGE_NAME = "${IMAGE_BASENAME}-${MACHINE}-${DISTRO_VERSION}"
IMAGE_NAME[vardepsexclude] += "DISTRO_VERSION"
# For now...
IMAGE_FEATURES += "empty-root-password allow-empty-password"
MACHINE_EXTRA_RRECOMMENDS_append_wandboard = " cryptodev-module"
VIRTUAL-RUNTIME_init_manager = "systemd"
VIRTUAL-RUNTIME_dev_manager  = "systemd"
VIRTUAL-RUNTIME_syslog = "busybox-syslog"
```

## layers/meta-magos/conf/layer.conf
```bitbake
BBPATH =. "${LAYERDIR}:"
BBFILES += "${LAYERDIR}/recipes-*/*/*.bb ${LAYERDIR}/recipes-*/*/*.bbappend"

BBFILE_COLLECTIONS += "magos"
BBFILE_PATTERN_magos = "^${LAYERDIR}/"
BBFILE_PRIORITY_magos = "50"

LAYERVERSION_magos = "4"
```

## layers/meta-magos/conf/machine/include/wandboard.inc
```bitbake
# Common settings for wandboard boards

include conf/machine/include/imx-base.inc
include conf/machine/include/tune-cortexa9.inc

SERIAL_CONSOLE = "115200 ttymxc0"

MACHINE_FEATURES += "pci touchscreen"

KERNEL_IMAGETYPE = "zImage"

UBOOT_MACHINE = "wandboard_config"
SPL_BINARY = "SPL"
UBOOT_MAKE_TARGET = ""
UBOOT_SUFFIX = "img"
```

## layers/meta-magos/conf/machine/jetson-tx1.conf
```bitbake
#@TYPE: Machine
#@NAME: Nvidia Jetson TX1
#@DESCRIPTION: Nvidia Jetson TX1 dev board

require conf/machine/include/tegra210.inc

KERNEL_DEVICETREE ?= "tegra210-jetson-tx1-p2597-2180-a01-devkit.dtb"


UBOOT_MACHINE = "p2371-2180_defconfig"

SDCARD_ROOTFS ?= "${DEPLOY_DIR_IMAGE}/${IMAGE_NAME}.rootfs.ext3"
MACHINE_GSTREAMER_1_0_PLUGIN += "gstreamer1.0-plugins-nveglgles gstreamer1.0-omx-tegra"

KERNEL_MODULE_AUTOLOAD = ""

LICENSE_FLAGS_WHITELIST_append = " commercial_gstreamer1.0-omx-tegra"

IMAGE_CLASSES += "image_types_fsl image_types_tegra"

EMMC_SIZE ?= "15758000128"
EMMC_DEVSECT_SIZE ?= "512"
BOOTPART_SIZE ?= "8388608"
BOOTPART_LIMIT ?= "10485760"
ROOTFSPART_SIZE ?= "12884901888"
ODMDATA ?= "0x84000"
EMMC_BCT ?= "P2180_A00_LP4_DSC_204Mhz.cfg"
NVIDIA_BOARD ?= "t210ref"
NVIDIA_PRODUCT ?= "p2371-2180-devkit"
NVIDIA_BOARD_CFG ?= "board_config_p2597-devkit.xml"
PARTITION_LAYOUT_TEMPLATE ?= "gnu_linux_tegraboot_emmc_full.xml"
NVIDIA_CHIP = "0x21"
```

## layers/meta-magos/conf/machine/wandboard.conf
```bitbake
#@TYPE: Machine
#@NAME: Wandboard i.MX6 Wandboard Quad/Dual
#@SOC: i.MX6Q
#@DESCRIPTION: Machine configuration for i.MX6 Wandboard Quad
#@MAINTAINER: Alfonso Tames <alfonso@tames.com>

SDCARD_ROOTFS ?= "${IMGDEPLOYDIR}/${IMAGE_NAME}.rootfs.ext4"

MACHINEOVERRIDES =. "mx6:mx6dl:mx6q:"

include conf/machine/include/imx-base.inc
include conf/machine/include/tune-cortexa9.inc

SOC_FAMILY = "mx6:mx6dl:mx6q"

UBOOT_MAKE_TARGET = ""
SPL_BINARY = "SPL"
UBOOT_SUFFIX = "img"
UBOOT_MACHINE = "wandboard_config"

KERNEL_DEVICETREE = "imx6q-wandboard-revc1.dtb \
                     imx6q-wandboard-revb1.dtb \
                     imx6dl-wandboard-revc1.dtb \
                     imx6dl-wandboard-revb1.dtb"
KERNEL_IMAGETYPE = "zImage"

MACHINE_FEATURES += "bluetooth pci wifi touchscreen"

MACHINE_EXTRA_RRECOMMENDS += " \
  bcm4329-nvram-config \
  bcm4330-nvram-config \
  imx-codec-aac \
"

SERIAL_CONSOLE = "115200 ttymxc0"
```
